## customer/packages/mps_atcmd_test/Config.in
```kconfig
menu "TELIT Sample Code"

config PACKAGE_mps_atcmd_test
	bool "mps-atcmd-test"
	default y
	help
		This is mps at command test package.
```

## customer/packages/mps_qmi_test/Config.in
```kconfig
config PACKAGE_mps_qmi_test
	tristate "MPs QMI Test"
	depends on PACKAGE_diag && PACKAGE_qmiservices && PACKAGE_qmiidl && PACKAGE_qmi && PACKAGE_qmi-framework && PACKAGE_libqcmap_client && PACKAGE_libqcmaputils && PACKAGE_libqmi && PACKAGE_libqmi-ip && PACKAGE_dsutils
	help
		MPs QMI Test utility for Telit modules.
```

## customer/packages/mps_tns/Config.in
```kconfig
config PACKAGE_mps_tns
	tristate "TNS (Time Network Synchronization)"
	depends on PACKAGE_diag && PACKAGE_qmiservices && PACKAGE_qmiidl && PACKAGE_qmi && PACKAGE_qmi-framework && PACKAGE_libqcmap_client && PACKAGE_libqcmaputils && PACKAGE_libqmi && PACKAGE_libqmi-ip && PACKAGE_dsutils
	help
		TNS (Time Network Synchronization) application for Telit modules.
		Monitors NR5G SIB9 time synchronization using QMI NAS messages.
```

## customer/packages/nas_nr5g_indications/Config.in
```kconfig
config PACKAGE_nas_nr5g_indications
	tristate "TNS (Time Network Synchronization)"
	depends on PACKAGE_diag && PACKAGE_qmiservices && PACKAGE_qmiidl && PACKAGE_qmi && PACKAGE_qmi-framework && PACKAGE_libqcmap_client && PACKAGE_libqcmaputils && PACKAGE_libqmi && PACKAGE_libqmi-ip && PACKAGE_dsutils
	help
		TNS (Time Network Synchronization) application for Telit modules.
		Monitors NR5G SIB9 time synchronization using QMI NAS messages.
```
